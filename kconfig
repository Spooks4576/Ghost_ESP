## kconfig
```kconfig
menu "Ghost ESP Options"

    menu "LED Options"
    
    config USE_NEOPIXEL
        bool "Use Neopixel RGB LEDs"
        default n
        help
            Enable Neopixel RGB LED support. When enabled, a single data pin will be used for RGB control.
    
    config LED_DATA_PIN
        int "LED Data Pin"
        default 0
        depends on USE_NEOPIXEL
        help
            Set the data pin for Neopixel LEDs.
    
    config NUM_LEDS
        int "Number of LEDs"
        default 0
        help
            Set the number of LEDs connected.
    
    config RED_RGB_PIN
        int "Red RGB Pin"
        default 0
        depends on !USE_NEOPIXEL
        help
            Define the pin for the red color of RGB LED when not using Neopixel.
    
    config GREEN_RGB_PIN
        int "Green RGB Pin"
        default 0
        depends on !USE_NEOPIXEL
        help
            Define the pin for the green color of RGB LED when not using Neopixel.
    
    config BLUE_RGB_PIN
        int "Blue RGB Pin"
        default 0
        depends on !USE_NEOPIXEL
        help
            Define the pin for the blue color of RGB LED when not using Neopixel.
    
    endmenu
    
    menu "Display Options"
    
    config WITH_SCREEN
        bool "Enable Screen Support"
        default n
        help
            Enable or disable screen support.
    
    config TFT_WIDTH
        int "TFT Width"
        default 240
        depends on WITH_SCREEN
        help
            Set the width of the TFT display.
    
    config TFT_HEIGHT
        int "TFT Height"
        default 320
        depends on WITH_SCREEN
        help
            Set the height of the TFT display.
    
    config USE_TOUCHSCREEN
        bool "Enable Touchscreen"
        default n
        help
            Enable touchscreen input.
    
    config USE_JOYSTICK
        bool "Enable Joystick"
        default n
        help
            Enable joystick input.
    
    config USE_CARDPUTER
        bool "Enable Cardputer"
        default n
        help
            Enable Cardputer input.
    
    config USE_7_INCHER
        bool "Use 7-inch Display"
        default n
        help
            Set to enable 7-inch display support.
    
    config Waveshare_LCD
        bool "Enable Waveshare LCD"
        default n
        help
            Enable support for Waveshare LCD.
    
    config Crowtech_LCD
        bool "Enable Crowtech LCD"
        default n
        help
            Enable support for Crowtech LCD.
    
    config Sunton_LCD
        bool "Enable Sunton LCD"
        default n
        help
            Enable support for Sunton LCD.
    
    config USE_ILI9341_2
        bool "Use ILI9341 2nd Display Driver"
        default n
        help
            Enable support for ILI9341 display module.
    
    endmenu

    menu  "Ghost Board Config"
        config IS_GHOST_BOARD
            bool "Enable Ghost Board Configuration"
            default n
            help
                Enable configuration for Ghost board.

        config GHOST_GPS_MODE
            bool "Enable GPS Mode for Ghost Board"
            default n
            depends on IS_GHOST_BOARD
            help
                Enable GPS Mode for Ghost Board.

        config GHOST_MARAUDER_MODE
            bool "Enable Marauder Controller Mode for Ghost Board"
            default n
            depends on IS_GHOST_BOARD
            help
                Enable Marauder Controller Mode for Ghost Board.

    endmenu
    
    menu "GPS Configuration"
    
    config HAS_GPS
        bool "Enable GPS"
        default n
        help
            Enable GPS support.
    
    config GPS_UART_RX_PIN
        int "GPS UART RX Pin"
        default 16
        depends on HAS_GPS
        help
            Define the UART RX pin for GPS.
    
    config GPS_UART_TX_PIN
        int "GPS UART TX Pin"
        default 17
        depends on HAS_GPS
        help
            Define the UART TX pin for GPS.
    
    endmenu
    
    menu "SPI and MMC Configuration"
    
    config USING_SPI
        bool "Enable SPI"
        default n
        help
            Enable SPI communication.
    
    config USING_MMC
        bool "Enable MMC"
        default n
        help
            Enable MMC support.
    
    config SD_SPI_CS_PIN
        int "SD Card SPI CS Pin"
        default 4
        help
            Define the Chip Select (CS) pin for SD Card SPI.
    
    config SD_SPI_CLK_PIN
        int "SD Card SPI CLK Pin"
        default 18
        help
            Define the Clock (CLK) pin for SD Card SPI.
    
    config SD_SPI_MISO_PIN
        int "SD Card SPI MISO Pin"
        default 19
        help
            Define the MISO pin for SD Card SPI.
    
    config SD_SPI_MOSI_PIN
        int "SD Card SPI MOSI Pin"
        default 23
        help
            Define the MOSI pin for SD Card SPI.
    
    endmenu
    
    endmenu    
```

## main/Kconfig.projbuild
```kconfig
menu "Ghost ESP Options"

    menu "LED Options"
    
    config USE_NEOPIXEL
        bool "Use Neopixel RGB LEDs"
        default n
        help
            Enable Neopixel RGB LED support. When enabled, a single data pin will be used for RGB control.
    
    config LED_DATA_PIN
        int "LED Data Pin"
        default 0
        depends on USE_NEOPIXEL
        help
            Set the data pin for Neopixel LEDs.
    
    config NUM_LEDS
        int "Number of LEDs"
        default 0
        help
            Set the number of LEDs connected.
    
    config RED_RGB_PIN
        int "Red RGB Pin"
        default 0
        depends on !USE_NEOPIXEL
        help
            Define the pin for the red color of RGB LED when not using Neopixel.
    
    config GREEN_RGB_PIN
        int "Green RGB Pin"
        default 0
        depends on !USE_NEOPIXEL
        help
            Define the pin for the green color of RGB LED when not using Neopixel.
    
    config BLUE_RGB_PIN
        int "Blue RGB Pin"
        default 0
        depends on !USE_NEOPIXEL
        help
            Define the pin for the blue color of RGB LED when not using Neopixel.
    
    endmenu
    
    menu "Display Options"
    
    config WITH_SCREEN
        bool "Enable Screen Support"
        default n
        help
            Enable or disable screen support.
    
    config TFT_WIDTH
        int "TFT Width"
        default 240
        depends on WITH_SCREEN
        help
            Set the width of the TFT display.
    
    config TFT_HEIGHT
        int "TFT Height"
        default 320
        depends on WITH_SCREEN
        help
            Set the height of the TFT display.
    
    config USE_TOUCHSCREEN
        bool "Enable Touchscreen"
        default n
        help
            Enable touchscreen input.
    
    config USE_JOYSTICK
        bool "Enable Joystick"
        default n
        help
            Enable joystick input.
    
    config USE_CARDPUTER
        bool "Enable Cardputer"
        default n
        help
            Enable Cardputer input.
    
    config USE_7_INCHER
        bool "Use 7-inch Display"
        default n
        help
            Set to enable 7-inch display support.
    
    config Waveshare_LCD
        bool "Enable Waveshare LCD"
        default n
        help
            Enable support for Waveshare LCD.
    
    config Crowtech_LCD
        bool "Enable Crowtech LCD"
        default n
        help
            Enable support for Crowtech LCD.
    
    config Sunton_LCD
        bool "Enable Sunton LCD"
        default n
        help
            Enable support for Sunton LCD.
    
    config USE_ILI9341_2
        bool "Use ILI9341 2nd Display Driver"
        default n
        help
            Enable support for ILI9341 display module.

    config HAS_BATTERY
        bool "Enable power saving"
        default n
        help
            Enable power saving features if you have a battery.
    
    endmenu

    menu  "Ghost Board Config"
        config IS_GHOST_BOARD
            bool "Enable Ghost Board Configuration"
            default n
            help
                Enable configuration for Ghost board.

        config GHOST_GPS_MODE
            bool "Enable GPS Mode for Ghost Board"
            default n
            depends on IS_GHOST_BOARD
            help
                Enable GPS Mode for Ghost Board.

        config GHOST_MARAUDER_MODE
            bool "Enable Marauder Controller Mode for Ghost Board"
            default n
            depends on IS_GHOST_BOARD
            help
                Enable Marauder Controller Mode for Ghost Board.

    endmenu
    
    menu "GPS Configuration"
    
    config HAS_GPS
        bool "Enable GPS"
        default n
        help
            Enable GPS support.
    
    config GPS_UART_RX_PIN
        int "GPS UART RX Pin"
        default 16
        depends on HAS_GPS
        help
            Define the UART RX pin for GPS.


    config NMEA_PARSER_RING_BUFFER_SIZE
        int "NMEA Parser Ring Buffer Size"
        range 0 2048
        depends on HAS_GPS
        default 1024
        help
            Size of the ring buffer used for UART Rx channel.

    config NMEA_PARSER_TASK_STACK_SIZE
        int "NMEA Parser Task Stack Size"
        range 0 4096
        depends on HAS_GPS
        default 3072
        help
            Stack size of NMEA Parser task.

    config NMEA_PARSER_TASK_PRIORITY
        int "NMEA Parser Task Priority"
        range 0 24
        depends on HAS_GPS
        default 2
        help
            Priority of NMEA Parser task.

    menu "NMEA Statement Support"
        comment "At least one statement must be selected"
        config NMEA_STATEMENT_GGA
            bool "GGA Statement"
            default y
            depends on HAS_GPS
            help
                Enabling this option will parse the following parameter from GGA statement:

                - Latitude, Longitude, Altitude;
                - Number of satellites in use, fix status (no fix, GPS, DGPS), UTC time;

        config NMEA_STATEMENT_GSA
            bool "GSA Statement"
            default y
            depends on HAS_GPS
            help
                Enabling this option will parse the following parameter from GSA statement:

                - Position/Vertical/Horizontal dilution of precision;
                - Fix mode (no fix, 2D, 3D fix);
                - IDs of satellites in use;

        config NMEA_STATEMENT_GSV
            bool "GSV Statement"
            default y
            depends on HAS_GPS
            help
                Enabling this option will parse the following parameter from GSV statement:

                - Number of satellites in view;
                - Optional details of each satellite in view;

        config NMEA_STATEMENT_RMC
            bool "RMC Statement"
            default y
            depends on HAS_GPS
            help
                Enabling this option will parse the following parameter from RMC statement:

                - Validity of GPS signal;
                - Ground speed (knots) and course over ground (degrees);
                - Magnetic variation;
                - UTC date;

        config NMEA_STATEMENT_GLL
            bool "GLL Statement"
            default y
            depends on HAS_GPS
            help
                Enabling this option will parse the following parameter from GLL statement:

                - Latitude, Longitude;
                - UTC time;

        config NMEA_STATEMENT_VTG
            bool "VTG Statement"
            default y
            depends on HAS_GPS
            help
                Enabling this option will parse the following parameter from VTG statement:

                - Ground speed (knots, km/h) and course over ground (degrees);
                - Magnetic variation;

    endmenu
    
    endmenu
    
    menu "SPI and MMC Configuration"
    
    config USING_SPI
        bool "Enable SPI"
        default n
        help
            Enable SPI communication.
    
    config USING_MMC
        bool "Enable MMC"
        default n
        help
            Enable MMC support.
    
    
    config SD_SPI_CS_PIN
        int "SD Card SPI CS Pin"
        default 4
        depends on USING_SPI
        help
            Define the Chip Select (CS) pin for SD Card SPI.
    
    config SD_SPI_CLK_PIN
        int "SD Card SPI CLK Pin"
        default 18
        depends on USING_SPI
        help
            Define the Clock (CLK) pin for SD Card SPI.
    
    config SD_SPI_MISO_PIN
        int "SD Card SPI MISO Pin"
        default 19
        depends on USING_SPI
        help
            Define the MISO pin for SD Card SPI.
    
    config SD_SPI_MOSI_PIN
        int "SD Card SPI MOSI Pin"
        default 23
        depends on USING_SPI
        help
            Define the MOSI pin for SD Card SPI.
    
    endmenu
    
endmenu    
```
